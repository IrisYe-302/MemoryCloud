## esp/ble-printer-test/main/Kconfig.projbuild
```kconfig
menu "Memory Cloud BLE test"
    config MEMORY_TEST_PRINTER_ADDRESS
        string "Printer Bluetooth address (AA:BB:CC:DD:EE:FF)"
        default ""
        help
            Set the address of your own printer. The local sdkconfig is ignored
            by Git; never put a personal address in sdkconfig.defaults.
endmenu
```

## esp/ble-printer-test/sdkconfig.defaults
```kconfig
CONFIG_IDF_TARGET="esp32s3"
CONFIG_BT_ENABLED=y
CONFIG_BT_NIMBLE_ENABLED=y
CONFIG_BT_BLUEDROID_ENABLED=n
CONFIG_BT_NIMBLE_ROLE_CENTRAL=y
CONFIG_BT_NIMBLE_ROLE_OBSERVER=y
CONFIG_BT_NIMBLE_MAX_CONNECTIONS=1
CONFIG_ESP_CONSOLE_USB_SERIAL_JTAG=y
```

## esp/printer-node/sdkconfig.defaults
```kconfig
CONFIG_IDF_TARGET="esp32s3"
CONFIG_BT_ENABLED=y
CONFIG_BT_NIMBLE_ENABLED=y
CONFIG_BT_BLUEDROID_ENABLED=n
CONFIG_BT_NIMBLE_ROLE_CENTRAL=y
CONFIG_BT_NIMBLE_ROLE_OBSERVER=y
CONFIG_BT_NIMBLE_MAX_CONNECTIONS=1
CONFIG_ESP_CONSOLE_USB_SERIAL_JTAG=y
CONFIG_MBEDTLS_CERTIFICATE_BUNDLE=y
CONFIG_MBEDTLS_CERTIFICATE_BUNDLE_DEFAULT_FULL=y
CONFIG_ESP_COEX_SW_COEXIST_ENABLE=y
CONFIG_PARTITION_TABLE_CUSTOM=y
CONFIG_PARTITION_TABLE_CUSTOM_FILENAME="partitions.csv"
CONFIG_PARTITION_TABLE_FILENAME="partitions.csv"
CONFIG_ESPTOOLPY_FLASHSIZE_4MB=y
CONFIG_ESPTOOLPY_FLASHSIZE="4MB"
```

## esp/status-panel/main/Kconfig.projbuild
```kconfig
menu "Memory Cloud status panel"
config MEMORY_LCD_ST7789
    bool "Enable physical 170x320 ST7789 LCD (confirm controller first)"
    default n
if MEMORY_LCD_ST7789
config MEMORY_LCD_SCLK
    int "SCL / SPI clock GPIO"
    range -1 48
    default -1
config MEMORY_LCD_MOSI
    int "SDA / SPI MOSI GPIO"
    range -1 48
    default -1
config MEMORY_LCD_RESET
    int "RES GPIO"
    range -1 48
    default -1
config MEMORY_LCD_DC
    int "DC GPIO"
    range -1 48
    default -1
config MEMORY_LCD_CS
    int "CS GPIO"
    range -1 48
    default -1
config MEMORY_LCD_BLK
    int "BLK GPIO (-1 when wired to 3.3 V per module instructions)"
    range -1 48
    default -1
config MEMORY_LCD_X_GAP
    int "X RAM offset (verify with module documentation/test pattern)"
    range 0 70
    default 35
config MEMORY_LCD_INVERT
    bool "Invert panel colors"
    default y
config MEMORY_LCD_BGR
    bool "Use BGR pixel order"
    default n
endif
config MEMORY_DEMO
    bool "Use simulated status messages (no networking or GPIO)"
    default y
    help
        Exercise the display states over the serial monitor before wiring hardware.
        When disabled, accept one JSON status message per line on the console.
config MEMORY_STALE_SECONDS
    int "Seconds before server status becomes stale"
    range 5 300
    default 15
endmenu
```
